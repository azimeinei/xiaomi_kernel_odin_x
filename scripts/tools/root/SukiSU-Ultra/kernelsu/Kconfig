## scripts/tools/root/SukiSU-Ultra/kernelsu/Kconfig
```kconfig
menu "KernelSU"

config KSU
	tristate "KernelSU function support"
	default y
	help
	  Enable kernel-level root privileges on Android System.
	  To compile as a module, choose M here: the
	  module will be called kernelsu.

# For easier extern ifdef handling
config RKSU
	bool "RKSU compat, do not modify"
	default y

config KSU_DEBUG
	bool "KernelSU debug mode"
	depends on KSU
	default n
	help
	  Enable KernelSU debug mode.

config KSU_ALLOWLIST_WORKAROUND
	bool "KernelSU allowlist workaround"
	depends on KSU
	default n
	help
	  Enable workaround for broken allowlist save

config KPM
	bool "Enable SukiSU KPM"
	depends on KSU && 64BIT
	default n
	help
	  Enabling this option will activate the KPM feature of SukiSU.
	  This option is suitable for scenarios where you need to force KPM to be enabled.
	  but it may affect system stability.
	select KALLSYMS
	select KALLSYMS_ALL

config KSU_MANUAL_HOOK
	bool "KernelSU manual hook mode."
	depends on KSU && KSU != m
	default y if !KPROBES
	default n
	help
	  Enable manual hook support.

config KSU_SHOULD_USE_NEW_TP
	bool "KernelSU tracepoint+kretprobe hook"
	depends on KSU && !KSU_MANUAL_HOOK
	depends on KRETPROBES && KPROBES && HAVE_SYSCALL_TRACEPOINTS
	default y if KPROBES && KRETPROBES && HAVE_SYSCALL_TRACEPOINTS
	default n
	help
	  Enable KPROBES, KRETPROBES and TRACEPOINT hook for KernelSU core.
	  This should not be used on kernel below 5.10.

config KSU_SUSFS
	bool "SUSFS Inline Hook"
	depends on KSU && KSU != m
	default n
	help
	  Patch and Enable SUSFS to kernel with KernelSU.

config KSU_SUSFS_SUS_PATH
	bool "Enable to hide suspicious path"
	depends on KSU_SUSFS
	default y

config KSU_SUSFS_SUS_MOUNT
	bool "Enable to hide suspicious mounts"
	depends on KSU_SUSFS
	default y

config KSU_SUSFS_SUS_KSTAT
	bool "Enable to spoof suspicious kstat"
	depends on KSU_SUSFS
	default y

config KSU_SUSFS_SPOOF_UNAME
	bool "Enable to spoof uname"
	depends on KSU_SUSFS
	default y

config KSU_SUSFS_ENABLE_LOG
	bool "Enable susf log"
	depends on KSU_SUSFS
	default y

config KSU_SUSFS_HIDE_KSU_SUSFS_SYMBOLS
	bool "Hide ksu and susfs symbols"
	depends on KSU_SUSFS
	default y

config KSU_SUSFS_SPOOF_CMDLINE_OR_BOOTCONFIG
	bool "Enable to spoof cmdline or bootconfig"
	depends on KSU_SUSFS
	default y

config KSU_SUSFS_OPEN_REDIRECT
	bool "Enable open redirect"
	depends on KSU_SUSFS
	default y

config KSU_SUSFS_SUS_SU
	bool "Enable sus_su"
	depends on KSU_SUSFS
	default n

endmenu
```
